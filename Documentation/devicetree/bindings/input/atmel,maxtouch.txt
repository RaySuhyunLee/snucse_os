## Documentation/devicetree/bindings/input/atmel,maxtouch.txt
```
Atmel maXTouch touchscreen/touchpad

Required properties:
- compatible:
    atmel,maxtouch

- reg: The I2C address of the device

- interrupts: The sink for the touchpad's IRQ output
    See ../interrupt-controller/interrupts.txt

Optional properties for main touchpad device:

- linux,gpio-keymap: An array of up to 4 entries indicating the Linux
    keycode generated by each GPIO. Linux keycodes are defined in
    <dt-bindings/input/input.h>.

- skip-cfg-load: This property can be used when no configuration file is
    provided and want to skip the loading of the cfg.

- switch-xy: This property can be used to switch x/y axis by S/W. This option
    is useful when the cfg is not provided.

Example:

	touch@4b {
		compatible = "atmel,maxtouch";
		reg = <0x4b>;
		interrupt-parent = <&gpio>;
		interrupts = <TEGRA_GPIO(W, 3) IRQ_TYPE_LEVEL_LOW>;
	};
```
