/*
 * SAMSUNG SHIRI board device tree source
 *
 * Copyright (c) 2014 Samsung Electronics Co., Ltd.
 *		http://www.samsung.com
 *
 * This program is free software; you can redistribute it and/or modify
 * it under the terms of the GNU General Public License version 2 as
 * published by the Free Software Foundation.
*/

#define PIN_CON_INPUT		0
#define PIN_CON_OUTPUT		1

#define PIN_PULL_NONE		0
#define PIN_PULL_DOWN		1
#define PIN_PULL_UP			3

#define PIN_PDN_OUT0		0
#define PIN_PDN_OUT1		1
#define PIN_PDN_INPUT		2
#define PIN_PDN_PREV		3

#define PIN_IN(_pin, _pull)				\
	_pin {								\
		samsung,pins = #_pin;			\
		samsung,pin-function = <0>;		\
		samsung,pin-pud = <PIN_PULL_ ##_pull>;	\
	}

#define PIN_OUT(_pin)					\
	_pin {								\
		samsung,pins = #_pin;			\
		samsung,pin-function = <1>;		\
		samsung,pin-pud = <0>;			\
	}

#define PIN_OUT_SET(_pin, _val)			\
	_pin {								\
		samsung,pins = #_pin;			\
		samsung,pin-function = <1>;		\
		samsung,pin-pud = <0>;			\
		samsung,pin-val	= <_val>;		\
	}

#define PIN_SLP(_pin, _mode, _pull)		\
	_pin {								\
		samsung,pins = #_pin;			\
		samsung,pin-con-pdn = <PIN_PDN_ ##_mode>;	\
		samsung,pin-pud-pdn = <PIN_PULL_ ##_pull>;	\
	}

&pinctrl_0 {
	pinctrl-names = "sleep";
	pinctrl-0 = <&sleep0>;
	sleep0: sleep-state {
		PIN_SLP(gpa0-0, INPUT, DOWN);
		PIN_SLP(gpa0-1, OUT0,  NONE);
		PIN_SLP(gpa0-2, INPUT, DOWN);
		PIN_SLP(gpa0-3, OUT1,  NONE);
		PIN_SLP(gpa0-4, INPUT, DOWN);
		PIN_SLP(gpa0-5, OUT0,  NONE);
		PIN_SLP(gpa0-6, INPUT, NONE);
		PIN_SLP(gpa0-7, INPUT, NONE);

		PIN_SLP(gpa1-0, INPUT, NONE);
		PIN_SLP(gpa1-1, OUT0,  NONE);
		PIN_SLP(gpa1-2, INPUT, NONE);
		PIN_SLP(gpa1-3, INPUT, NONE);
		PIN_SLP(gpa1-4, INPUT, DOWN);
		PIN_SLP(gpa1-5, INPUT, DOWN);

		PIN_SLP(gpb-0, INPUT, NONE);
		PIN_SLP(gpb-1, INPUT, NONE);
		PIN_SLP(gpb-2, INPUT, NONE);
		PIN_SLP(gpb-3, INPUT, NONE);
		PIN_SLP(gpb-4, INPUT, DOWN);
		PIN_SLP(gpb-5, INPUT, DOWN);
		PIN_SLP(gpb-6, INPUT, DOWN);
		PIN_SLP(gpb-7, INPUT, DOWN);

		PIN_SLP(gpc0-0, INPUT, DOWN);
		PIN_SLP(gpc0-1, INPUT, DOWN);
		PIN_SLP(gpc0-2, INPUT, DOWN);
		PIN_SLP(gpc0-3, INPUT, DOWN);
		PIN_SLP(gpc0-4, INPUT, DOWN);

		PIN_SLP(gpc1-0, INPUT, DOWN);
		PIN_SLP(gpc1-1, INPUT, DOWN);
		PIN_SLP(gpc1-2, INPUT, DOWN);
		PIN_SLP(gpc1-3, INPUT, DOWN);
		PIN_SLP(gpc1-4, INPUT, DOWN);

		PIN_SLP(gpd0-0, INPUT, DOWN);
		PIN_SLP(gpd0-1, INPUT, DOWN);
		PIN_SLP(gpd0-2, INPUT, NONE);
		PIN_SLP(gpd0-3, INPUT, NONE);

		PIN_SLP(gpd1-0, INPUT, NONE);
		PIN_SLP(gpd1-1, INPUT, NONE);
		PIN_SLP(gpd1-2, INPUT, NONE);
		PIN_SLP(gpd1-3, INPUT, NONE);
	};
};

&pinctrl_1 {
	pinctrl-names = "sleep";
	pinctrl-0 = <&sleep1>;
	sleep1: sleep-state {
		PIN_SLP(gpe0-0, INPUT, DOWN);
		PIN_SLP(gpe0-1, INPUT, DOWN);
		PIN_SLP(gpe0-2, INPUT, NONE);
		PIN_SLP(gpe0-3, INPUT, DOWN);
		PIN_SLP(gpe0-4, OUT0,  NONE);
		PIN_SLP(gpe0-5, OUT0,  NONE);
		PIN_SLP(gpe0-6, INPUT, DOWN);
		PIN_SLP(gpe0-7, INPUT, DOWN);

		PIN_SLP(gpe1-0, OUT0,  NONE);
		PIN_SLP(gpe1-1, OUT1,  DOWN);
		PIN_SLP(gpe1-2, INPUT, DOWN);
		PIN_SLP(gpe1-3, INPUT, DOWN);
		PIN_SLP(gpe1-4, PREV, UP);
		PIN_SLP(gpe1-5, OUT1, UP);
		PIN_SLP(gpe1-6, PREV, UP);
		PIN_SLP(gpe1-7, INPUT, DOWN);

		PIN_SLP(gpe2-0, INPUT, DOWN);
		PIN_SLP(gpe2-1, INPUT, DOWN);
		PIN_SLP(gpe2-2, INPUT, DOWN);

		PIN_SLP(gpk0-0, INPUT, DOWN);
		PIN_SLP(gpk0-1, INPUT, NONE);
		PIN_SLP(gpk0-2, OUT0,  NONE);
		PIN_SLP(gpk0-3, INPUT, NONE);
		PIN_SLP(gpk0-4, INPUT, NONE);
		PIN_SLP(gpk0-5, INPUT, NONE);
		PIN_SLP(gpk0-6, INPUT, NONE);
		PIN_SLP(gpk0-7, INPUT, NONE);

		PIN_SLP(gpk1-0, INPUT, DOWN);
		PIN_SLP(gpk1-1, INPUT, NONE);
		PIN_SLP(gpk1-2, INPUT, DOWN);
		PIN_SLP(gpk1-3, INPUT, NONE);
		PIN_SLP(gpk1-4, INPUT, NONE);
		PIN_SLP(gpk1-5, INPUT, NONE);
		PIN_SLP(gpk1-6, INPUT, NONE);

		PIN_SLP(gpk2-0, INPUT, DOWN);
		PIN_SLP(gpk2-1, INPUT, NONE);
		PIN_SLP(gpk2-2, INPUT, NONE);
		PIN_SLP(gpk2-3, INPUT, NONE);
		PIN_SLP(gpk2-4, INPUT, NONE);
		PIN_SLP(gpk2-5, INPUT, NONE);
		PIN_SLP(gpk2-6, INPUT, NONE);

		PIN_SLP(gpl0-0, INPUT, NONE);
		PIN_SLP(gpl0-1, INPUT, NONE);
		PIN_SLP(gpl0-2, INPUT, NONE);
		PIN_SLP(gpl0-3, INPUT, NONE);

		PIN_SLP(gpm0-0, INPUT, DOWN);
		PIN_SLP(gpm0-1, INPUT, DOWN);
		PIN_SLP(gpm0-2, INPUT, DOWN);
		PIN_SLP(gpm0-3, INPUT, DOWN);
		PIN_SLP(gpm0-4, INPUT, DOWN);
		PIN_SLP(gpm0-5, INPUT, DOWN);
		PIN_SLP(gpm0-6, INPUT, DOWN);
		PIN_SLP(gpm0-7, INPUT, DOWN);

		PIN_SLP(gpm1-0, INPUT, DOWN);
		PIN_SLP(gpm1-1, INPUT, DOWN);
		PIN_SLP(gpm1-2, INPUT, DOWN);
		PIN_SLP(gpm1-3, INPUT, DOWN);
		PIN_SLP(gpm1-4, INPUT, DOWN);
		PIN_SLP(gpm1-5, INPUT, DOWN);
		PIN_SLP(gpm1-6, INPUT, DOWN);

		PIN_SLP(gpm2-0, INPUT, DOWN);
		PIN_SLP(gpm2-1, INPUT, DOWN);
		PIN_SLP(gpm2-2, INPUT, DOWN);
		PIN_SLP(gpm2-3, INPUT, DOWN);
		PIN_SLP(gpm2-4, INPUT, DOWN);

		PIN_SLP(gpm3-0, INPUT, DOWN);
		PIN_SLP(gpm3-1, INPUT, DOWN);
		PIN_SLP(gpm3-2, INPUT, DOWN);
		PIN_SLP(gpm3-3, INPUT, DOWN);
		PIN_SLP(gpm3-4, INPUT, DOWN);
		PIN_SLP(gpm3-5, INPUT, DOWN);
		PIN_SLP(gpm3-6, INPUT, DOWN);
		PIN_SLP(gpm3-7, INPUT, DOWN);

		PIN_SLP(gpm4-0, INPUT, DOWN);
		PIN_SLP(gpm4-1, INPUT, DOWN);
		PIN_SLP(gpm4-2, INPUT, NONE);
		PIN_SLP(gpm4-3, INPUT, NONE);
		PIN_SLP(gpm4-4, INPUT, DOWN);
		PIN_SLP(gpm4-5, INPUT, DOWN);
		PIN_SLP(gpm4-6, INPUT, DOWN);
		PIN_SLP(gpm4-7, INPUT, DOWN);

		PIN_IN(gpx0-0, DOWN);
		PIN_IN(gpx0-1, DOWN);
		PIN_IN(gpx0-2, NONE);
		PIN_IN(gpx0-3, NONE);
		PIN_IN(gpx0-4, DOWN);
		PIN_IN(gpx0-5, NONE);
		PIN_IN(gpx0-6, DOWN);
		PIN_IN(gpx0-7, DOWN);

		PIN_IN(gpx1-0, DOWN);
		PIN_IN(gpx1-1, DOWN);
		PIN_IN(gpx1-2, NONE);
		PIN_IN(gpx1-3, NONE);
		PIN_IN(gpx1-4, DOWN);
		PIN_IN(gpx1-5, DOWN);
		PIN_IN(gpx1-6, NONE);
		PIN_IN(gpx1-7, DOWN);

		PIN_IN(gpx2-0, DOWN);
		PIN_IN(gpx2-1, NONE);
		PIN_IN(gpx2-2, NONE);
		PIN_IN(gpx2-3, DOWN);
		PIN_IN(gpx2-4, DOWN);
		PIN_IN(gpx2-5, DOWN);
		PIN_IN(gpx2-6, DOWN);
		/*PIN_IN(gpx2-7, DOWN);*/

		PIN_IN(gpx3-0, NONE);
		PIN_IN(gpx3-1, DOWN);
		PIN_IN(gpx3-2, DOWN);
		PIN_IN(gpx3-3, NONE);
		PIN_IN(gpx3-4, NONE);
		PIN_IN(gpx3-5, DOWN);
		PIN_IN(gpx3-6, NONE);
		PIN_IN(gpx3-7, NONE);
	};
};
